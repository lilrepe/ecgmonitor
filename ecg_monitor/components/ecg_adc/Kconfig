## ecg_monitor/components/ecg_adc/Kconfig
```kconfig
menu "ECG ADC Component"

    config ECG_UNIT_TEST
        bool "Enable ECG Unit Tests (bật chế độ test)"
        default n
        help
            Khi bật:
              - test_ecg_adc.c được biên dịch vào firmware
              - Các handle ADC nội bộ được expose để test
              - app_main gọi ecg_adc_run_tests() thay vì chạy ECG task
            Khi tắt (mặc định):
              - Firmware hoạt động bình thường
              - Không có overhead của Unity test framework

endmenu
```

## ecg_monitor/main/Kconfig.projbuild
```kconfig
menu "ECG Monitor Configuration"

    config ECG_SERIAL_DEBUG
        bool "Serial Debug Mode (ADC only, print to UART)"
        default n
        help
            Khi bật: app chỉ chạy ADC task + serial print task.
            In dữ liệu thô lên UART để verify phần cứng.
            Tắt toàn bộ inference / display / network.
            Dùng để kiểm tra tín hiệu ECG trước khi tích hợp hệ thống đầy đủ.

    config ECG_WIFI_SSID
        string "WiFi SSID"
        default "YOUR_SSID"
        help
            SSID của mạng WiFi để ESP32-S3 kết nối.

    config ECG_WIFI_PASS
        string "WiFi Password"
        default "YOUR_PASSWORD"
        help
            Mật khẩu WiFi.

    config ECG_ENABLE_MONITOR
        bool "Enable system monitor task (debug)"
        default n
        help
            Bật task in thống kê queue/heap mỗi 10 giây.
            Chỉ dùng khi debug, tắt khi production.

    choice ECG_DENOISE_BACKEND
        prompt "ECG denoise backend"
        default ECG_DENOISE_CLASSIC
        help
            Chon cach loc nhieu cho tin hieu ECG sau ADC.
            Classic filter dang chay that: high-pass, notch, low-pass.
            AI denoise hien la khung placeholder de sau nay gan model.

        config ECG_DENOISE_CLASSIC
            bool "Classic DSP filters (high-pass + notch + low-pass)"
            help
                Dung bo loc so IIR de chay duoc ngay, khong can model AI.

        config ECG_DENOISE_AI
            bool "AI denoise placeholder"
            help
                Khung de tich hop model sau nay. Hien tai compile duoc,
                nhung chi pass-through va ghi log can gan model.
    endchoice

    config ECG_WS_PORT
        int "WebSocket server port"
        default 80
        range 1 65535
        help
            Port cho HTTP/WebSocket server.

    config ECG_SAMPLE_RATE
        int "ADC sample rate (Hz)"
        default 500
        range 100 1000
        help
            Tần số lấy mẫu. Phải >= 2x tần số cao nhất của ECG (~150Hz).
            500Hz là khuyến nghị.

endmenu
```

## ecg_monitor/sdkconfig.defaults
```kconfig
# FreeRTOS: tăng tick rate lên 1000Hz để vTaskDelay(1) = 1ms (thay vì 10ms mặc định)
CONFIG_FREERTOS_HZ=1000

# Cho phép task chạy trên core cụ thể
CONFIG_FREERTOS_UNICORE=n

# Stack overflow check (development)
CONFIG_FREERTOS_WATCHPOINT_END_OF_STACK=y

# Log level
CONFIG_LOG_DEFAULT_LEVEL_INFO=y

# ADC
CONFIG_ADC_SUPPRESS_DEPRECATE_WARN=y

# WiFi
CONFIG_ESP_WIFI_STATIC_RX_BUFFER_NUM=10
CONFIG_ESP_WIFI_DYNAMIC_TX_BUFFER_NUM=32

# WebSocket / HTTP server
CONFIG_HTTPD_WS_SUPPORT=y

# Tăng stack cho main task (dùng khi init)
CONFIG_ESP_MAIN_TASK_STACK_SIZE=8192
CONFIG_ECG_UNIT_TEST=y

# Serial Debug Mode (Yêu cầu 1) — chỉ ADC + UART print, bỏ qua inference/display/network
# Tắt dòng này khi chuyển sang Yêu cầu 2 (OLED)
# CONFIG_ECG_SERIAL_DEBUG is not set

# Default denoise backend: classic DSP filters. AI path is placeholder only.
CONFIG_ECG_DENOISE_CLASSIC=y
# CONFIG_ECG_DENOISE_AI is not set
```
